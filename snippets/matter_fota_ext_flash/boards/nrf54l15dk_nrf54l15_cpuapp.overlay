/*
 * Copyright (c) 2026 Nordic Semiconductor ASA
 *
 * SPDX-License-Identifier: LicenseRef-Nordic-5-Clause
 */

#include <matter/nrf54l15dk_cpuapp_partitions_ext_flash.dtsi>

/ {
	chosen {
		nordic,pm-ext-flash = &mx25r64;
	};
};
