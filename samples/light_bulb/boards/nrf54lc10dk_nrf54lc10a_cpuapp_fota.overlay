/*
 * Copyright (c) 2026 Nordic Semiconductor ASA
 *
 * SPDX-License-Identifier: LicenseRef-Nordic-5-Clause
 */

#include <nrf54lc10_cpuapp_partitions.dtsi>
#include <fota_internal/nrf54lc10dk_cpuapp_partitions.dtsi>
