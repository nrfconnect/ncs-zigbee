## samples/light_bulb/sysbuild/mcuboot/boards/nrf54lm20dk_nrf54lm20a_cpuapp_fota.conf
```kconfig
#
# Copyright (c) 2026 Nordic Semiconductor ASA
#
# SPDX-License-Identifier: LicenseRef-Nordic-5-Clause
#

CONFIG_HW_STACK_PROTECTION=n
CONFIG_BOOT_WATCHDOG_FEED=n

CONFIG_ASSERT_VERBOSE=n
CONFIG_ASSERT_NO_FILE_INFO=y
CONFIG_PRINTK=n

# External SPI NOR for FOTA secondary slot (slot1 on mx25r64)
CONFIG_GPIO=y
CONFIG_SPI=y
CONFIG_SPI_NOR=y
CONFIG_SPI_NOR_SFDP_DEVICETREE=y
CONFIG_SPI_NOR_FLASH_LAYOUT_PAGE_SIZE=4096
CONFIG_NORDIC_QSPI_NOR=n
CONFIG_MULTITHREADING=y

CONFIG_TICKLESS_KERNEL=y
CONFIG_NRF_RRAM_WRITE_BUFFER_SIZE=32
```

## samples/light_switch/boards/nrf5340dk_nrf5340_cpuapp_fota.conf
```kconfig
#
# Copyright (c) 2025 Nordic Semiconductor ASA
#
# SPDX-License-Identifier: LicenseRef-Nordic-5-Clause
#

#######################
# Zigbee FOTA overlay #
#######################

# Configure QSPI for external flash
CONFIG_NORDIC_QSPI_NOR=y
CONFIG_NORDIC_QSPI_NOR_FLASH_LAYOUT_PAGE_SIZE=4096
CONFIG_NORDIC_QSPI_NOR_STACK_WRITE_BUFFER_SIZE=16

CONFIG_DFU_MULTI_IMAGE=y
CONFIG_NRF53_ENFORCE_IMAGE_VERSION_EQUALITY=y
```

## samples/light_switch/boards/nrf54lm20dongle_nrf54lm20b_cpuapp.conf
```kconfig
#
# Copyright (c) 2026 Nordic Semiconductor ASA
#
# SPDX-License-Identifier: LicenseRef-Nordic-5-Clause
#

CONFIG_CDC_ACM_SERIAL_VID=0x1915
CONFIG_CDC_ACM_SERIAL_PID=0x0100
CONFIG_CDC_ACM_SERIAL_MANUFACTURER_STRING="Nordic Semiconductor ASA"
CONFIG_CDC_ACM_SERIAL_PRODUCT_STRING="Zigbee Light Switch"
```

## samples/light_switch/sysbuild/mcuboot/boards/nrf5340dk_nrf5340_cpuapp.conf
```kconfig
#
# Copyright (c) 2025 Nordic Semiconductor ASA
#
# SPDX-License-Identifier: LicenseRef-Nordic-5-Clause
#

CONFIG_HW_STACK_PROTECTION=n
CONFIG_BOOT_WATCHDOG_FEED=n

# Disable all debug features
CONFIG_ASSERT_VERBOSE=n
CONFIG_ASSERT_NO_FILE_INFO=y
CONFIG_PRINTK=n

CONFIG_MAIN_STACK_SIZE=8192

# Configure MCUboot features
CONFIG_NRF53_MULTI_IMAGE_UPDATE=y
CONFIG_BOOT_UPGRADE_ONLY=y
CONFIG_MCUBOOT_DOWNGRADE_PREVENTION=y
CONFIG_MCUBOOT_VERIFY_IMG_ADDRESS=n

# Enable flash simulator
CONFIG_PCD_APP=y
CONFIG_FLASH_SIMULATOR=y
CONFIG_FLASH_SIMULATOR_DOUBLE_WRITES=y
CONFIG_FLASH_SIMULATOR_STATS=n

# Configure QSPI for external flash
CONFIG_FLASH=y
CONFIG_FPROTECT=y
CONFIG_NORDIC_QSPI_NOR=y
CONFIG_NORDIC_QSPI_NOR_FLASH_LAYOUT_PAGE_SIZE=4096
CONFIG_NORDIC_QSPI_NOR_STACK_WRITE_BUFFER_SIZE=16
```

## subsys/lib/zigbee_app_utils/Kconfig
```kconfig
#
# Copyright (c) 2020 Nordic Semiconductor
#
# SPDX-License-Identifier: LicenseRef-Nordic-5-Clause
#

menuconfig ZIGBEE_APP_UTILS
	bool "Enable API for Zigbee application utilities"
	help
	  This allows Zigbee applications to call API:

	  - for parsing and converting Zigbee data types
	  - for handling common ZBOSS signals, with behavior depending on the device role
	  - for indicating the device status at the network using onboard LEDs

if ZIGBEE_APP_UTILS

# Configure ZIGBEE_APP_UTILS_LOG_LEVEL
module = ZIGBEE_APP_UTILS
module-str = Zigbee application utilities
source "${ZEPHYR_BASE}/subsys/logging/Kconfig.template.log_config"

menuconfig ZIGBEE_FACTORY_RESET
	bool "Enable API for Zigbee factory reset"
	default y
	imply DK_LIBRARY

if ZIGBEE_FACTORY_RESET

config FACTORY_RESET_PRESS_TIME_SECONDS
	int "Minimal Factory Reset button press time"
	default 5
	help
	  How long a specified button has to be pressed to initiate Factory Reset procedure

endif # ZIGBEE_FACTORY_RESET

config ZIGBEE_APP_IO_SHELL
	bool "Shell commands for simulating buttons and reading LED states"
	depends on SHELL
	depends on DK_LIBRARY
	help
	  Adds the app_io shell command, which simulates button presses
	  of any duration and prints the state of the LEDs.

config ZIGBEE_DEMO_COMMISSIONING
	bool "Allow joining without install codes (insecure, demo only)"
	depends on ZIGBEE_ROLE_COORDINATOR || ZIGBEE_ROLE_ROUTER
	help
	  When the device acts as Trust Center, the default signal handler
	  sets the install code policy to ZB_INSTALL_CODE_NOT_REQUIRED.
	  Devices without an install code can then join using the
	  well-known link key, which any device in radio range can use to
	  obtain the network key.
	  By default, ZBOSS requires install codes on the Trust Center.
	  This option is not the BDB 3.1 backwards compatibility mode: it
	  stays active across all commissioning windows until reboot.
	  Use this option only for demonstrations and testing, never in
	  products.

endif # ZIGBEE_APP_UTILS
```

## subsys/lib/zigbee_matter_coexistence/Kconfig
```kconfig
#
# Copyright (c) 2026 Nordic Semiconductor ASA
#
# SPDX-License-Identifier: LicenseRef-Nordic-5-Clause
#

menuconfig ZIGBEE_MATTER_COEXISTENCE
	bool "Matter + Zigbee coexistence runtime for combined applications"
	depends on CHIP && SETTINGS && ZIGBEE_ADD_ON
	depends on BT
	depends on CHIP_LAST_FABRIC_REMOVED_ERASE_AND_REBOOT
	select ZIGBEE_MATTER_PROTOCOL_STATE
	default y
	help
	  Shared orchestration layer for samples that host both Matter and
	  Zigbee stacks on the same 802.15.4 radio. Owns the Zigbee and
	  Matter worker threads, the radio handover on first Matter
	  commissioning, and updates the persistent protocol state across
	  reboots and factory resets.

	  On last-fabric removal the device reboots and resumes the protocol
	  selected by CONFIG_ZIGBEE_MATTER_PROTOCOL_STATE_DEFAULT_PROTOCOL.

if ZIGBEE_MATTER_COEXISTENCE

config ZIGBEE_MATTER_COEXISTENCE_BT_ADV_WHILE_ZIGBEE
	bool "Allow CHIPoBLE commissioning while Zigbee is active"
	default y
	depends on CHIP_ENABLE_PAIRING_AUTOSTART
	help
	  When enabled, Matter may start BLE commissioning advertising while
	  the Zigbee stack owns the 802.15.4 radio. The Zigbee worker waits
	  for the first CHIPoBLE advertising-started event before chaining
	  sample button handlers and starting Zigbee.

	  Requires CONFIG_CHIP_ENABLE_PAIRING_AUTOSTART in the application.

	  When disabled, the sample must call
	  zigbee_matter_coexistence_signal_matter_board_init() after Matter
	  server init completes.
	  The Zigbee worker then proceeds without waiting for Thread
	  or DNS-SD. Set CONFIG_CHIP_ENABLE_PAIRING_AUTOSTART=n if Matter
	  commissioning over BLE is not needed until after a protocol switch.

config ZIGBEE_MATTER_COEXISTENCE_BUTTON_SWITCH
	bool "Enable user protocol switch on button long press"
	default y
	help
	  When enabled, samples may call
	  zigbee_matter_coexistence_process_switch_button() to switch between
	  Zigbee and Matter using a long button press.

	  When disabled, protocol changes rely on Matter commissioning events
	  and factory reset only.

config ZIGBEE_MATTER_COEXISTENCE_SWITCH_BUTTON_PRESS_TIME_SECONDS
	int "Protocol-switch button hold time (seconds)"
	depends on ZIGBEE_MATTER_COEXISTENCE_BUTTON_SWITCH
	range 1 30
	default 5
	help
	  Hold time required when pressing the protocol-switch button.
	  When the timer expires, the coexistence runtime attempts to switch
	  to the other protocol unless pairing or commissioning is in progress.

config ZIGBEE_MATTER_COEXISTENCE_ZIGBEE_THREAD_STACK_SIZE
	int "Zigbee worker thread stack size (bytes)"
	default 2048

config ZIGBEE_MATTER_COEXISTENCE_ZIGBEE_THREAD_PRIORITY
	int "Zigbee worker thread priority"
	default 3

config ZIGBEE_MATTER_COEXISTENCE_MATTER_THREAD_STACK_SIZE
	int "Matter worker thread stack size (bytes)"
	default 3072

config ZIGBEE_MATTER_COEXISTENCE_MATTER_THREAD_PRIORITY
	int "Matter worker thread priority"
	default 3

module = ZIGBEE_MATTER_COEXISTENCE
module-str = Matter/Zigbee coexistence
source "${ZEPHYR_BASE}/subsys/logging/Kconfig.template.log_config"

endif # ZIGBEE_MATTER_COEXISTENCE
```

## subsys/lib/zigbee_matter_protocol_state/Kconfig
```kconfig
#
# Copyright (c) 2026 Nordic Semiconductor ASA
#
# SPDX-License-Identifier: LicenseRef-Nordic-5-Clause
#

menuconfig ZIGBEE_MATTER_PROTOCOL_STATE
	bool "Persistent protocol state for combined Matter + Zigbee applications"
	depends on ZIGBEE_MATTER_COEXISTENCE && SETTINGS
	default y
	help
	  Small settings-backed module that tracks which protocol (Zigbee or
	  Matter) the combined application should resume after a reboot. Used
	  by samples that host both stacks on the same 802.15.4 radio.

if ZIGBEE_MATTER_PROTOCOL_STATE

choice ZIGBEE_MATTER_PROTOCOL_STATE_DEFAULT_PROTOCOL
	prompt "Default protocol on first boot"
	default ZIGBEE_MATTER_PROTOCOL_STATE_DEFAULT_ZIGBEE
	help
	  Applied when no protocol state has been stored yet (factory-fresh
	  device), after a Matter factory reset, or after the settings entry
	  was erased. Subsequent boots use the persisted value until one of
	  those events applies the default again.

config ZIGBEE_MATTER_PROTOCOL_STATE_DEFAULT_ZIGBEE
	bool "Zigbee"
	help
	  Start on Zigbee: bring up the Zigbee stack and hand the 802.15.4
	  radio to ZBOSS unless a previous run already persisted Matter.

config ZIGBEE_MATTER_PROTOCOL_STATE_DEFAULT_MATTER
	bool "Matter"
	help
	  Start on Matter: skip Zigbee stack start and hand the 802.15.4 radio
	  to OpenThread unless a previous run already persisted Zigbee.

endchoice

module = ZIGBEE_MATTER_PROTOCOL_STATE
module-str = Matter/Zigbee protocol state
source "${ZEPHYR_BASE}/subsys/logging/Kconfig.template.log_config"

endif # ZIGBEE_MATTER_PROTOCOL_STATE
```
