/*
 * Copyright (c) 2026 Nordic Semiconductor ASA
 *
 * SPDX-License-Identifier: LicenseRef-Nordic-5-Clause
 */

#include <nrf52833_partitions.dtsi>
#include <mcuboot_usb_transport/nrf52833_partitions.dtsi>

/ {
	chosen {
		zephyr,code-partition = &boot_partition;
		ncs,zigbee-uart = &cdc_acm_uart0;
	};
};

&zephyr_udc0 {
	cdc_acm_uart0: cdc_acm_uart {
		compatible = "zephyr,cdc-acm-uart";
	};
};
