/*
 * Copyright (c) 2026 Nordic Semiconductor ASA
 *
 * SPDX-License-Identifier: LicenseRef-Nordic-5-Clause
 */

#include <matter/nrf54l15dk_cpuapp_partitions.dtsi>

/ {
	chosen {
		zephyr,code-partition = &boot_partition;
	};
};

&cpuapp_rram {
	reg = <0x0 DT_SIZE_K(1524)>;
};
