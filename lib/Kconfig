## lib/Kconfig
```kconfig
#
# Copyright (c) 2021 Nordic Semiconductor
#
# SPDX-License-Identifier: LicenseRef-Nordic-5-Clause
#

if ZIGBEE_ADD_ON

menu "ZBOSS library configuration"

config ZBOSS_SOURCES_AVAILABLE
	bool

# Add a menu option to switch between platform designs.
choice ZIGBEE_LIBRARY_PLATFORM
	prompt "Zigbee platform design"
	default ZIGBEE_LIBRARY_SOC

config ZIGBEE_LIBRARY_SOC
	bool "System-on-Chip"
	help
	  The Zigbee stack, as well as the application is implemented on the SoC

config ZIGBEE_LIBRARY_NCP_DEV
	bool "Network co-processor (connectivity device)"
	help
	  The Zigbee stack is implemented on the connectivity SoC,
	  but the application is implemented on the host MCU

endchoice

# Add a menu option to switch between subsets of Zigbee Green Power features.
choice ZIGBEE_GP_FEATURES
	prompt "Zigbee Green Power feature set configuration"
	default ZIGBEE_GP_PB

config ZIGBEE_GP_NONE
	bool "Disable Zigbee Green Power functionality"
	help
	  This option is valid only when building ZBOSS without application layer

config ZIGBEE_GP_PB
	bool "Enable Zigbee Green Power Proxy Basic functionality"

config ZIGBEE_GP_CB
	bool "Enable Zigbee Green Power Combo Basic functionality [EXPERIMENTAL]"
	select EXPERIMENTAL
	depends on !ZIGBEE_ROLE_END_DEVICE && ZBOSS_SOURCES_AVAILABLE

endchoice

config ZIGBEE_ENABLE_TRACES
	bool "Use ZBOSS libraries, dedicated for debugging issues [EXPERIMENTAL]"
	select EXPERIMENTAL
	help
	  Those libraries do not include additional debug symbols, but they include
	  extended set of ZBOSS binary traces, that allow Nordic's support team to debug issues.

config APP_LINK_WITH_ZBOSS
	bool
	help
	  Link application with ZBOSS library

endmenu

endif #ZIGBEE_ADD_ON
```

## samples/light_bulb/sysbuild/mcuboot/boards/nrf54lm20dk_nrf54lm20a_cpuapp.conf
```kconfig
#
# Copyright (c) 2026 Nordic Semiconductor ASA
#
# SPDX-License-Identifier: LicenseRef-Nordic-5-Clause
#

# Board-specific MCUBoot configuration for nRF54LM20DK

CONFIG_HW_STACK_PROTECTION=n
CONFIG_BOOT_WATCHDOG_FEED=n

# Internal flash only - no external flash SPI configuration needed
# CONFIG_SPI=n
# CONFIG_SPI_NOR=n

# Increase the maximum number of sectors for combined Zigbee+Matter
CONFIG_BOOT_MAX_IMG_SECTORS=512

# Enable tickless kernel for proper reboot handling
CONFIG_TICKLESS_KERNEL=y
```

## samples/light_switch/snippets/low_power/boards/nrf52840dk_nrf52840.conf
```kconfig
#
# Copyright (c) 2025 Nordic Semiconductor
#
# SPDX-License-Identifier: LicenseRef-Nordic-5-Clause
#

# Workaround for NCS 2.9.0/3.0.0
# Uses kernel timer instead of dedicated timer2 to avoid 10µA sleep current increase
# when timer2 is explicitly enabled in overlay files
# TODO: Remove this when upgrading to NCS 3.1.0+
CONFIG_ZIGBEE_TIME_KTIMER=y
```

## samples/light_switch/sysbuild/mcuboot/boards/nrf54l15dk_nrf54l10_cpuapp.conf
```kconfig
#
# Copyright (c) 2024 Nordic Semiconductor ASA
#
# SPDX-License-Identifier: LicenseRef-Nordic-5-Clause
#

# TODO: Workaround, disable memory guard to avoid false faults in application after boot
CONFIG_HW_STACK_PROTECTION=n

CONFIG_FPROTECT=n

CONFIG_BOOT_WATCHDOG_FEED=n

# nRF54L15DK uses SPI NOR external flash
CONFIG_GPIO=y
CONFIG_SPI=y
CONFIG_SPI_NOR=y
CONFIG_SPI_NOR_SFDP_DEVICETREE=y
CONFIG_SPI_NOR_FLASH_LAYOUT_PAGE_SIZE=4096
CONFIG_NORDIC_QSPI_NOR=n

# required by SPI driver
CONFIG_MULTITHREADING=y

CONFIG_PM_PARTITION_SIZE_MCUBOOT=0xFB00

# Adjust the maximum sectors to the app image size of ~1.4MB
CONFIG_BOOT_MAX_IMG_SECTORS=976

CONFIG_UPDATEABLE_IMAGE_NUMBER=1

# Currently, without tickless kernel, the SYSCOUNTER value after the software
# reset is not set properly and due to that the first system interrupt is not called
# in the proper time - the SYSCOUNTER value is set to the value from before
# reset + 1. Hence, the reboot time increases more and more.
# To avoid it enable tickles kernel for mcuboot.
CONFIG_TICKLESS_KERNEL=y

# Ensure the fastest RRAM write operations
CONFIG_NRF_RRAM_WRITE_BUFFER_SIZE=32
```

## samples/light_switch/sysbuild/mcuboot/boards/nrf54lm20dk_nrf54lm20a_cpuapp.conf
```kconfig
#
# Copyright (c) 2025 Nordic Semiconductor ASA
#
# SPDX-License-Identifier: LicenseRef-Nordic-5-Clause
#

CONFIG_HW_STACK_PROTECTION=n
CONFIG_BOOT_WATCHDOG_FEED=n

# nRF54LM20DK uses SPI NOR external flash
CONFIG_GPIO=y
CONFIG_SPI=y
CONFIG_SPI_NOR=y
CONFIG_SPI_NOR_SFDP_DEVICETREE=y
CONFIG_SPI_NOR_FLASH_LAYOUT_PAGE_SIZE=4096
CONFIG_PM_OVERRIDE_EXTERNAL_DRIVER_CHECK=y

# Increase the maximum number of sectors to 512 to fit the big image size (> 1024 kB).
CONFIG_BOOT_MAX_IMG_SECTORS=512
```

## west.yml
```yaml
# Copyright (c) 2024 Nordic Semiconductor ASA
# SPDX-License-Identifier: Apache-2.0

manifest:
  remotes:
    - name: ncs
      url-base: https://github.com/nrfconnect
    - name: ncs_ssh
      url-base: git@github.com:nrfconnect

  projects:
    - name: nrf
      remote: ncs
      repo-path: sdk-nrf
      revision: pull/27711/head
      import: true
    - name: nrf-802154
      remote: ncs_ssh
      repo-path: sdk-nrf-802154
      path: nrf-802154
      revision: pull/719/head
```
